## lib/src/main/cpp/supplicant/wpa_supplicant_defconfig
```kconfig
# wpa_supplicant build configuration for NDK static library build
CONFIG_DRIVER_NL80211=y
CONFIG_DRIVER_WIRED=y
CONFIG_IEEE8021X_EAPOL=y
CONFIG_EAP_MD5=y
CONFIG_EAP_MSCHAPV2=y
CONFIG_EAP_TLS=y
CONFIG_EAP_PEAP=y
CONFIG_EAP_TTLS=y
CONFIG_EAP_GTC=y
CONFIG_EAP_OTP=y
CONFIG_EAP_LEAP=y
CONFIG_EAP_WSC=y
CONFIG_WPS=y
CONFIG_CTRL_IFACE=unix
CONFIG_CTRL_IFACE_UNIX=y
CONFIG_BACKEND=file
CONFIG_LIBNL32=y
CONFIG_TLS=openssl
CONFIG_IEEE80211W=y
CONFIG_DEBUG_FILE=y
CONFIG_NO_RANDOM_POOL=y
```
